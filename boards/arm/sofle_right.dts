// filepath: c:\Users\Gerardo\Desktop\Teclados\zmk_config_sofleWifi\boards\arm\sofle_right.dts

&spi1 {
    status = "okay";
    cs-gpios = <&gpio0 6 GPIO_ACTIVE_LOW>; // CS = P0.06 (D1)
    nice_view: nice_view@0 {
        compatible = "gooddisplay,gdeh0213b73";
        reg = <0>;
        spi-max-frequency = <8000000>;
        dc-gpios = <&gpio0 26 GPIO_ACTIVE_LOW>;    // DC = P0.26 (D4)
        reset-gpios = <&gpio0 18 GPIO_ACTIVE_LOW>; // RST = P0.18 (D5)
        busy-gpios = <&gpio0 24 GPIO_ACTIVE_HIGH>; // BUSY = P0.24 (D6)
    };
};